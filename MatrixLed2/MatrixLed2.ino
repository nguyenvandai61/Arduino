// 2-dimensional array of row pin numbers:
int R[] = {2, 7, A5, 5, 13, A4, 12, A2};
// 2-dimensional array of column pin numbers:
int C[] = {6, 11, 10, 1, A3, 4, 8, 9};
// Port 3 Not good change 3 -> 1


unsigned char BIT[8][8]={
    1,0,0,0,0,0,0,0,  
    0,0,0,0,0,0,0,0,  
    0,0,0,0,0,0,0,0,  
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    0,0,0,0,0,0,0,0,
};
unsigned char characterHEX[][8] = {
{B00000000,B00111100,B01100110,B01100110,B01111110,B01100110,B01100110,B01100110},
{B01111000,B01001000,B01001000,B01110000,B01001000,B01000100,B01000100,B01111100},
{B00000000,B00011110,B00100000,B01000000,B01000000,B01000000,B00100000,B00011110},
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{B00000000,B00111100,B00000100,B00001000,B00010000,B00100000,B00111100,B00000000}
};
char character[] = {'A', 'B', 'C', 'D', 'E', 'F', 'G', 'H', 'I', 'J', 'K', 'L', 'M', 'N', 'O', 'P', 'Q', 'R', 'S', 'T', 'U', 'V', 'W', 'X', 'Y', 'Z', '0', '1', '2', '3', '4', '5', '6', '7', '8', '9', ' '};



void setup()
{
  Serial.begin(9600);
  // iterate over the pins:
  for (int i = 0; i < 8; i++)
    // initialize the output pins:
  {
    pinMode(R[i], OUTPUT);
    pinMode(C[i], OUTPUT);
  }
  Serial.println("Nhap ten: ");

}

void loop()
{
  String string = "HELLO WORLD";
  Serial.println(string);

  for (int i = 0; i < 8; i++) {
    for (int j = 0; j < 8; j++) {
      Serial.print(BIT[i][j]);
    }
    Serial.println();
  }


 Display(BIT);
}

void Display(unsigned char dat[8][8])    
{  
  for(int c = 0; c<8;c++)  
  {  
    digitalWrite(C[c],LOW);//use thr column 
    //loop
    for(int r = 0;r<8;r++)  
    {  
      digitalWrite(R[r],dat[r][c]);  
    }  
    delay(1);  
    Clear();  //Remove empty display light
  }
    
}  

int Dao(int x) {
  if (x == 1)
    x = 0;
  else x = 1;
  return x;
}

/* LedMat chua ma tran ky tu moi*/
void LedMat(int x) {
  int val;
  for (int i = 0 ; i < 8 ; i++) {
    val = characterHEX[x][i];
    for (int j = 7; j >= 0; j--) {
      BIT[i][j] = val % 2;
      val /= 2;
    }
  }
}

/* Tat het led */
void Clear()
{
  for (int i = 0; i < 8; i++)
  {
    digitalWrite(R[i], HIGH);
    digitalWrite(C[i], LOW);
  }
}
